## firmware/pc-rly-wifi/sdkconfig.defaults
```kconfig
# PropertyCore Relay Firmware — sdkconfig defaults
# Targets: ESP32 (ESP-IDF v5.x)
# SKUs: PC-RLY-1CH-W, PC-RLY-2CH-W, PC-RLY-4CH-W, PC-RLY-6CH-W

# Increase main task stack (default 3584 is too small with Wi-Fi + MQTT init)
CONFIG_ESP_MAIN_TASK_STACK_SIZE=8192

# MQTT buffer
CONFIG_MQTT_BUFFER_SIZE=1024
CONFIG_MQTT_RECONNECT_TIMEOUT_MS=5000

# Wi-Fi buffers — reduce slightly to save RAM
CONFIG_ESP_WIFI_STATIC_RX_BUFFER_NUM=4
CONFIG_ESP_WIFI_DYNAMIC_RX_BUFFER_NUM=8

# FreeRTOS tick rate — 1ms resolution for debounce accuracy
CONFIG_FREERTOS_HZ=1000

# Disable Classic Bluetooth and BLE — not used, frees ~100KB flash
CONFIG_BT_ENABLED=n

# Log level — INFO in production (change to DEBUG for development)
CONFIG_LOG_DEFAULT_LEVEL_INFO=y
```

## meta-propertycore/conf/distro/propertycore.conf
```bitbake
# PropertyCore Distribution Configuration
# Yocto Scarthgap (5.0 LTS)

DISTRO = "propertycore"
DISTRO_NAME = "PropertyCore OS"
DISTRO_VERSION = "0.1"
DISTRO_CODENAME = "foundation"

# Inherit the poky distro as base, then override what we need
require conf/distro/poky.conf

# SDK version
SDK_VERSION = "${DISTRO_VERSION}"

# Distro features — keep minimal for embedded commercial use
# - systemd: production service manager
# - pam: required for SSH and auth
# - opengl: needed for future LVGL/display work
# - wifi: hub has Wi-Fi capability
# - bluetooth: future BLE device support
DISTRO_FEATURES = "acl ext2 ipv4 ipv6 largefile usbhost xattr pam \
                   systemd usrmerge wifi bluetooth opengl"

# Use systemd as the init manager (not SysVinit)
VIRTUAL-RUNTIME_init_manager = "systemd"
VIRTUAL-RUNTIME_initscripts = "systemd-compat-units"
DISTRO_FEATURES_BACKFILL_CONSIDERED:append = " sysvinit"

# Default timezone — can be overridden per deployment
DEFAULT_TIMEZONE = "Africa/Lagos"

# Package format — ipk is lightweight, suitable for embedded
PACKAGE_CLASSES = "package_ipk"

# Do not install recommended packages (keeps image lean)
NO_RECOMMENDATIONS = "1"

# Strip debug info from packages in the image (saves space)
INHIBIT_PACKAGE_DEBUG_SPLIT = "0"
```

## meta-propertycore/conf/layer.conf
```bitbake
# meta-propertycore layer configuration
# PropertyCore smart property automation platform layer

# Add this layer to BBPATH so BitBake can find it
BBPATH .= ":${LAYERDIR}"

# Add all recipes in this layer to BBFILES
BBFILES += "${LAYERDIR}/recipes-*/*/*.bb \
            ${LAYERDIR}/recipes-*/*/*.bbappend"

BBFILE_COLLECTIONS += "meta-propertycore"
BBFILE_PATTERN_meta-propertycore = "^${LAYERDIR}/"
BBFILE_PRIORITY_meta-propertycore = "10"

# Core layer dependency only — raspberrypi layer is optional (not required for QEMU builds)
LAYERDEPENDS_meta-propertycore = "core"

# Compatible with Yocto Scarthgap (5.0 LTS)
LAYERSERIES_COMPAT_meta-propertycore = "scarthgap"
```
